## config/west.yml
```yaml
manifest:
  remotes:
    - name: joselucassr
      url-base: https://github.com/joselucassr
  projects:
    - name: zmk
      remote: joselucassr
      revision: my-changes/split-encoder
      import: app/west.yml
  self:
    path: config
```
